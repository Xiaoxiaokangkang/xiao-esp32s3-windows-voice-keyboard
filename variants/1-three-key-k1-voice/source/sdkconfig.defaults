## variants/1-three-key-k1-voice/source/sdkconfig.defaults
```kconfig
CONFIG_ESP_CONSOLE_NONE=y
CONFIG_ESP_CONSOLE_SECONDARY_NONE=y
CONFIG_USB_DEVICE_UAC_AS_PART=y
CONFIG_UAC_SPEAKER_CHANNEL_NUM=0
CONFIG_UAC_MIC_CHANNEL_NUM=1
CONFIG_UAC_SAMPLE_RATE=48000
CONFIG_UAC_BIT_RESOLUTION_16=y
CONFIG_UAC_MIC_INTERVAL_MS=10
CONFIG_UAC_TINYUSB_TASK_PRIORITY=5
CONFIG_UAC_TINYUSB_TASK_CORE=-1
CONFIG_UAC_MIC_TASK_PRIORITY=6
CONFIG_UAC_MIC_TASK_CORE=-1
CONFIG_FREERTOS_HZ=1000
CONFIG_ESPTOOLPY_FLASHSIZE_8MB=y
```
